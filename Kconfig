## Kconfig
```kconfig
config ZMK_BEHAVIOR_LONG_PRESS
    bool "Long-press behavior"
    default y
    help
      Invoke a behavior only after its key remains held for a configured duration.

DT_COMPAT_ZMK_INPUT_PROCESSOR_ACCEL := zmk,input-processor-accel

config ZMK_INPUT_PROCESSOR_ACCEL
    bool "Pointer acceleration input processor"
    default $(dt_compat_enabled,$(DT_COMPAT_ZMK_INPUT_PROCESSOR_ACCEL))
    depends on ZMK_POINTING
    help
      Velocity-based pointer acceleration with a movement activation gate. Only
      built for boards that actually instantiate the node, which keeps
      pointer-less targets such as settings_reset unaffected.

DT_COMPAT_ZMK_INPUT_PROCESSOR_SWIPE_ARBITER := zmk,input-processor-swipe-arbiter

config ZMK_INPUT_PROCESSOR_SWIPE_ARBITER
    bool "Three-finger swipe arbiter input processor"
    default $(dt_compat_enabled,$(DT_COMPAT_ZMK_INPUT_PROCESSOR_SWIPE_ARBITER))
    depends on ZMK_POINTING
    help
      Collapses a stream of raw swipe direction samples into a single actuation
      in the dominant direction.

DT_COMPAT_ZMK_INPUT_PROCESSOR_SCROLL_SHORTCUT := zmk,input-processor-scroll-shortcut

config ZMK_INPUT_PROCESSOR_SCROLL_SHORTCUT
    bool "Scroll-to-shortcut input processor"
    default $(dt_compat_enabled,$(DT_COMPAT_ZMK_INPUT_PROCESSOR_SCROLL_SHORTCUT))
    depends on ZMK_POINTING
    help
      Turns accumulated travel on a relative scroll axis into a single key-combo
      actuation per gesture.

DT_COMPAT_ZMK_INPUT_PROCESSOR_ROTATE := zmk,input-processor-rotate

config ZMK_INPUT_PROCESSOR_ROTATE
    bool "Pointer rotation input processor"
    default $(dt_compat_enabled,$(DT_COMPAT_ZMK_INPUT_PROCESSOR_ROTATE))
    depends on ZMK_POINTING
    help
      Rotates relative pointer movement by a fixed angle to compensate for a
      trackpad that is physically mounted at an angle to the keyboard.

DT_COMPAT_ZMK_INPUT_PROCESSOR_TAP_DRAG := zmk,input-processor-tap-drag

config ZMK_INPUT_PROCESSOR_TAP_DRAG
    bool "Double-tap-and-hold drag input processor"
    default $(dt_compat_enabled,$(DT_COMPAT_ZMK_INPUT_PROCESSOR_TAP_DRAG))
    depends on ZMK_POINTING
    help
      Turns a tap followed straight away by a held touch into a left-button
      drag, like macOS's tap to drag.

DT_COMPAT_ZMK_BEHAVIOR_OS_SELECT := zmk,behavior-os-select
DT_COMPAT_ZMK_BEHAVIOR_OS_MODE := zmk,behavior-os-mode

config ZMK_BEHAVIOR_OS_SELECT
    bool "OS-select behavior"
    default $(dt_compat_enabled,$(DT_COMPAT_ZMK_BEHAVIOR_OS_SELECT))
    select TOUCAN_OS_MODE
    help
      Invoke one of two bindings depending on the current host-OS mode.

config ZMK_BEHAVIOR_OS_MODE
    bool "OS-mode behavior"
    default $(dt_compat_enabled,$(DT_COMPAT_ZMK_BEHAVIOR_OS_MODE))
    select TOUCAN_OS_MODE
    help
      Select or toggle the host-OS mode used by the OS-select behavior.

config TOUCAN_OS_MODE
    bool
    help
      Shared, persisted host-OS mode state. Selected automatically by the
      behaviors that need it.

config TOUCAN_OS_MODE_DEFAULT_WIN
    bool "Default to Windows OS mode"
    depends on TOUCAN_OS_MODE
    help
      Power on in Windows mode rather than macOS mode. Only applies until a
      mode has been stored; after that the saved value wins.
```

## config/west.yml
```yaml
manifest:
  remotes:
    - name: zmkfirmware
      url-base: https://github.com/zmkfirmware
    - name: caksoylar
      url-base: https://github.com/caksoylar
    - name: geeksville
      url-base: https://github.com/geeksville
    - name: beekeeb
      url-base: https://github.com/beekeeb
    - name: englmaxi
      url-base: https://github.com/englmaxi
  projects:
    - name: zmk
      remote: zmkfirmware
      import: app/west.yml
      revision: v0.3
    - name: zmk-rgbled-widget
      remote: caksoylar
      revision: v0.3
    - name: zmk_driver_azoteq
      remote: beekeeb
      revision: c329f309b7481e5723603550b15f48e24d0c8a6a
    - name: zmk-input-zoom
      remote: beekeeb
      revision: main
    # Status screen for the dongle's OLED. Pinned to the ZMK v0.3 line, the
    # same revision PandaKB's own dongle firmware uses.
    - name: zmk-dongle-display
      remote: englmaxi
      revision: v0.3
  self:
    path: config
```

## dts/bindings/behaviors/zmk,behavior-hyper-guard.yaml
```yaml
# Copyright (c) 2026 Colin Creasman
# SPDX-License-Identifier: MIT

description: |
  Taps a keycode like `&kp`, except when Ctrl, Shift, Alt and GUI are all held.

  With homerow mods, resting four fingers on the home row resolves every mod as
  held, so the next key can land as a Ctrl+Alt+Shift+GUI chord. On macOS that
  chord plus `.` starts a sysdiagnose, so the key is dropped while all four are
  held. Any other modifier combination passes through unchanged.

compatible: "zmk,behavior-hyper-guard"

include: one_param.yaml
```

## dts/bindings/behaviors/zmk,behavior-long-press.yaml
```yaml
description: Long-press behavior

compatible: "zmk,behavior-long-press"

include: zero_param.yaml

properties:
  bindings:
    type: phandles
    required: true

  duration-ms:
    type: int
    required: true
    description: Time the key must remain pressed before invoking the behavior.

  central:
    type: boolean
    description: >
      Invoke the behavior on the split central instead of on the part whose
      key was pressed. Needed for source-local behaviors like &bootloader to
      target a keyless dongle; without it they run on the half that owns the
      key.
```

## dts/bindings/behaviors/zmk,behavior-os-mode.yaml
```yaml
# Copyright (c) 2026 Colin Creasman
# SPDX-License-Identifier: MIT

description: |
  Sets the host-OS mode used by `zmk,behavior-os-select`.

  The chosen mode is persisted, so the keyboard comes back up in whichever mode
  it was last left in.

  Takes one parameter: 0 selects macOS, 1 selects Windows, 2 toggles.

compatible: "zmk,behavior-os-mode"

include: one_param.yaml
```

## dts/bindings/behaviors/zmk,behavior-os-select.yaml
```yaml
# Copyright (c) 2026 Colin Creasman
# SPDX-License-Identifier: MIT

description: |
  Invokes one of two bindings depending on the current host-OS mode.

  Used for the trackpad gestures, which need different shortcuts on macOS and
  Windows. The choice is made when the binding is pressed, and the same
  sub-binding is used for the matching release, so switching modes mid-press
  cannot leave a modifier stuck down.

compatible: "zmk,behavior-os-select"

include: zero_param.yaml

properties:
  bindings:
    type: phandle-array
    required: true
    description: >
      Exactly two behaviors: the macOS binding first, then the Windows binding.
```

## dts/bindings/behaviors/zmk,behavior-os-status.yaml
```yaml
description: Mirror the active host slot and OS mode to split-peripheral displays.
compatible: "zmk,behavior-os-status"
include: two_param.yaml
```

## dts/bindings/behaviors/zmk,behavior-win-switcher.yaml
```yaml
# Copyright (c) 2026 Colin Creasman
# SPDX-License-Identifier: MIT

description: |
  Windows three-finger contact holds Alt until the contact ends.
  Parameter 0 = right, 1 = left, 2 = up, 3 = down, 4 = contact.
  Left/right presses navigate repeatedly during contact; direction releases
  do nothing.
  Up/down end navigation until the next contact.
  Contact press/release starts/ends the session. Mac gestures do not use this behavior.

compatible: "zmk,behavior-win-switcher"

include: one_param.yaml

properties:
  tap-ms:
    type: int
    default: 12
    description: >
      Gap between key reports in a swipe sequence, allowing the host to see
      distinct taps. This is not a contact-release timeout.
```

## dts/bindings/input_processors/zmk,input-processor-accel.yaml
```yaml
# Copyright (c) 2026 Colin Creasman
# SPDX-License-Identifier: MIT

description: |
  Velocity-based pointer acceleration with a movement activation gate.

  At or below speed-threshold the raw delta is scaled by min-factor, so deliberate
  slow movement stays precise. Between speed-threshold and speed-max the factor
  follows acceleration-exponent up to max-factor, so a longer/faster stroke covers
  far more screen without raising the baseline sensitivity.

  Movement is suppressed entirely until activation-distance counts of travel have
  accumulated since the finger last left the pad, so brushing the trackpad while
  typing cannot nudge the cursor.

compatible: "zmk,input-processor-accel"

include: ip_zero_param.yaml

properties:
  type:
    type: int
    default: 2 # INPUT_EV_REL
    description: Input event type to accelerate.

  codes:
    type: array
    required: true
    description: Event codes to accelerate, typically INPUT_REL_X and INPUT_REL_Y.

  min-factor:
    type: int
    default: 1000
    description: >
      Factor (x1000) applied at or below speed-threshold. 1000 = 1.0x.
      Values under 1000 make slow movement finer than the raw report.

  max-factor:
    type: int
    default: 3000
    description: Factor (x1000) applied at or above speed-max.

  speed-threshold:
    type: int
    default: 500
    description: Speed in counts/second at or below which min-factor is applied.

  speed-max:
    type: int
    default: 3000
    description: Speed in counts/second at which max-factor is reached.

  acceleration-exponent:
    type: int
    default: 2
    description: >
      Shape of the curve between the two speeds. 1 is linear, 2 quadratic,
      3 cubic. Higher values keep the pointer slow for longer before ramping.

  activation-distance:
    type: int
    default: 0
    description: >
      Counts of accumulated travel required after a new touch before any movement
      is emitted. 0 disables the gate.

  activation-reset-ms:
    type: int
    default: 300
    description: >
      Idle gap between movement reports that re-arms the activation gate, used as
      a fallback if a touch-release event is ever missed.
```

## dts/bindings/input_processors/zmk,input-processor-rotate.yaml
```yaml
# Copyright (c) 2026 Colin Creasman
# SPDX-License-Identifier: MIT

description: |
  Rotates relative pointer movement by a fixed angle.

  The trackpad is mounted at an angle to the keyboard, but fingers arrive square
  to the keyboard, so a stroke that feels "straight up" registers as a diagonal.
  This processor applies a 2D rotation to the X/Y pair so screen movement lines
  up with the direction the hand actually moved.

  Only pointer movement is rotated. Scroll and the two/three-finger swipe
  gestures are resolved inside the Azoteq driver, upstream of any input
  processor, so they are unaffected.

  The driver always reports X immediately followed by Y for the same sample, and
  a rotation needs both axes at once. The processor therefore buffers X, does the
  maths when Y arrives, emits the rotated Y on that event, and carries the
  rotated X over to the next report.

compatible: "zmk,input-processor-rotate"

include: ip_zero_param.yaml

properties:
  angle:
    type: int
    required: true
    description: >
      Rotation in whole degrees, -180 to 180. Positive rotates movement
      counter-clockwise. If the cursor tracks the wrong diagonal, negate this.

  x-code:
    type: int
    default: 0 # INPUT_REL_X
    description: Relative axis treated as horizontal.

  y-code:
    type: int
    default: 1 # INPUT_REL_Y
    description: Relative axis treated as vertical.

  reset-ms:
    type: int
    default: 300
    description: >
      Idle gap that discards a buffered sample, used as a fallback if a
      touch-release event is ever missed.
```

## dts/bindings/input_processors/zmk,input-processor-scroll-shortcut.yaml
```yaml
# Copyright (c) 2026 Colin Creasman
# SPDX-License-Identifier: MIT

description: |
  Turns a two-finger swipe into a single key-combo actuation per gesture.

  The Azoteq driver only reports swipe buttons for three-finger movement; a
  two-finger swipe arrives as ordinary scroll. This processor accumulates the
  scroll axes and, once `threshold` counts of travel have built up in one
  direction, invokes one of two bindings exactly once. It then stays quiet until
  the fingers leave the pad, so a long swipe navigates one page rather than
  several.

  Because the trackpad is mounted at an angle, the accumulated vector is rotated
  by `angle` before the direction is judged, so the gesture lines up with the
  way the hand actually moved rather than with the sensor's axes. The driver
  reports only the dominant axis per sample, so both axes are accumulated across
  the whole gesture to reconstruct the direction.

compatible: "zmk,input-processor-scroll-shortcut"

include: ip_zero_param.yaml

properties:
  event-code:
    type: int
    default: 6 # INPUT_REL_HWHEEL
    description: Relative axis treated as horizontal.

  y-event-code:
    type: int
    default: 8 # INPUT_REL_WHEEL
    description: >
      Relative axis treated as vertical. Only used to judge direction; vertical
      events are passed through untouched so normal scrolling still works.

  y-invert:
    type: boolean
    description: >
      Negate the vertical axis before rotating. Set this when the driver has
      `invert-scroll-y`, so the rotation sees the same orientation as the
      pointer axes.

  angle:
    type: int
    default: 0
    description: >
      Rotation in whole degrees, applied to the accumulated vector before the
      direction is judged. Should match the pointer rotation. 0 disables the
      rotation and judges purely on the horizontal axis.

  threshold:
    type: int
    default: 120
    description: >
      Counts of accumulated travel along the rotated horizontal axis before the
      matching binding fires. Raise it if the gesture triggers too easily, lower
      it if a normal swipe is not enough.

  reset-ms:
    type: int
    default: 300
    description: >
      Idle gap that ends the gesture, used as a fallback if a touch-release
      event is ever missed.

  bindings:
    type: phandle-array
    required: true
    description: >
      Exactly two behaviors. The first fires on negative rotated travel, the
      second on positive.
```

## dts/bindings/input_processors/zmk,input-processor-swipe-arbiter.yaml
```yaml
# Copyright (c) 2026 Colin Creasman
# SPDX-License-Identifier: MIT

description: |
  Arbitrates raw three-finger swipe button events into a single, correctly
  directed actuation per gesture.

  The Azoteq driver decides a swipe direction from the first nonzero delta of a
  gesture and reports each axis independently, so the fingers settling at
  touchdown can fire the wrong axis. Its own throttle then blocks the real
  direction for the rest of the window, which is why an off-axis swipe is hard
  to land while a clean one feels instant.

  With the driver throttle turned down this processor sees a stream of direction
  samples instead. It suppresses them until one axis leads the other by `lead`
  samples, emits exactly one press/release pair in the winning direction, then
  stays silent until the fingers leave the pad.

compatible: "zmk,input-processor-swipe-arbiter"

include: ip_zero_param.yaml

properties:
  lead:
    type: int
    default: 2
    description: >
      How far ahead one axis must be before a direction is committed. 1 reacts
      fastest but keeps more of the driver's touchdown noise; higher values
      reject more noise at the cost of a little latency.

  max-samples:
    type: int
    default: 8
    description: >
      Fallback cap. Once this many samples have been seen the current leader is
      committed even without a full lead, so a sloppy diagonal still actuates
      rather than being silently dropped.

  reset-ms:
    type: int
    default: 400
    description: >
      Idle gap between swipe samples that ends the gesture, used as a fallback
      if a touch-release event is ever missed.
```
